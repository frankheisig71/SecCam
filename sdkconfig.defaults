## sdkconfig.defaults
```kconfig
CONFIG_PM_ENABLE=y
CONFIG_ESPTOOLPY_FLASHSIZE_16MB=y
CONFIG_ESPTOOLPY_FLASHSIZE="16MB"
CONFIG_PARTITION_TABLE_CUSTOM=y
CONFIG_PARTITION_TABLE_CUSTOM_FILENAME="partitions_16mb_singleapp.csv"
CONFIG_PARTITION_TABLE_FILENAME="partitions_16mb_singleapp.csv"
CONFIG_COMPILER_OPTIMIZATION_SIZE=y
CONFIG_COMPILER_OPTIMIZATION_ASSERTIONS_SILENT=y
CONFIG_SPIRAM=y
CONFIG_SPIRAM_MODE_OCT=y
CONFIG_SPIRAM_TYPE_ESPPSRAM64=y
CONFIG_SPIRAM_SPEED_80M=y
CONFIG_FLASH_PEDESTRIAN_DETECT_PICO_S8_V1=y
CONFIG_PEDESTRIAN_DETECT_MODEL_IN_FLASH_PARTITION=y
```
